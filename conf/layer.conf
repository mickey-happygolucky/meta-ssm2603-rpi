## conf/layer.conf
```bitbake
# We have a conf and classes directory, add to BBPATH
BBPATH .= ":${LAYERDIR}"
# We have recipes-* directories, add to BBFILES
BBFILES += "${LAYERDIR}/recipes-*/*/*.bb ${LAYERDIR}/recipes*/*/*.bbappend"

BBFILE_COLLECTIONS += "ssm2603-rpi"
BBFILE_PATTERN_ssm2603-rpi = "^${LAYERDIR}/"
BBFILE_PRIORITY_ssm2603-rpi = "10"
```
